## CMakeLists.txt
```
cmake_minimum_required(VERSION 3.20.0)

option(ILLIXR_HPM_PROFILE "Account Rocket HPM counters by scheduled plugin" OFF)
if(ILLIXR_HPM_PROFILE)
  list(APPEND EXTRA_CONF_FILE "${CMAKE_CURRENT_SOURCE_DIR}/config/hpm.conf")
endif()
find_package(Zephyr REQUIRED HINTS $ENV{ZEPHYR_BASE})
project(illixr_working)
add_compile_definitions(ILLIXR_HPM_PROFILE=$<BOOL:${ILLIXR_HPM_PROFILE}>)
if(ILLIXR_HPM_PROFILE)
  target_sources(app PRIVATE src/hpm.cpp)
  set_source_files_properties(src/hpm.cpp PROPERTIES COMPILE_OPTIONS "-fno-tree-vectorize")
endif()
include(cmake/illixr_openblas.cmake)
option(ILLIXR_DIAGNOSTIC_FAULTS "Preserve complete CPU fault registers in diagnostic builds" OFF)
option(ILLIXR_DIAGNOSTIC_RAW_TRAP "Capture fatal traps directly over HTIF, without kernel logging" OFF)
option(ILLIXR_DIAGNOSTIC_BLAS_PROGRESS "Trace BLAS self-test call entry/exit for stall diagnosis" OFF)
option(ILLIXR_DIAGNOSTIC_BLAS_IRQ_MASK "Mask IRQs around diagnostic numerical self-test calls" OFF)
option(ILLIXR_DIAGNOSTIC_BLAS_AB "Compare IRQ/fence modes within one diagnostic ELF" OFF)
option(ILLIXR_DIAGNOSTIC_RVV_FOCUSED "Run isolated TRSM tail and active-vector interrupt fixtures" OFF)
option(ILLIXR_DIAGNOSTIC_RVV_REJECT "Test rejected vector instructions using a private trap handler" OFF)
option(ILLIXR_DIAGNOSTIC_RVV_MEMORY "Test vector store followed by scalar load" OFF)
if(ILLIXR_DIAGNOSTIC_RVV_MEMORY)
  if(NOT ILLIXR_DIAGNOSTIC_RVV_FOCUSED)
    message(FATAL_ERROR "Vector memory diagnostic requires focused fixtures")
  endif()
  target_sources(app PRIVATE tests/rvv_focused/memory.S)
  target_compile_definitions(app PRIVATE ILLIXR_DIAGNOSTIC_RVV_MEMORY=1)
endif()
option(ILLIXR_DIAGNOSTIC_RVV_NATIVE_IRQ "Test active vectors with a private timer interrupt handler" OFF)
if(ILLIXR_DIAGNOSTIC_RVV_NATIVE_IRQ)
  if(NOT ILLIXR_DIAGNOSTIC_RVV_FOCUSED)
    message(FATAL_ERROR "Native-vector IRQ diagnostic requires focused fixtures")
  endif()
  target_sources(app PRIVATE tests/rvv_focused/native_irq.S)
  target_compile_definitions(app PRIVATE ILLIXR_DIAGNOSTIC_RVV_NATIVE_IRQ=1)
endif()
option(ILLIXR_DIAGNOSTIC_TRSM_CAPTURE "Capture first failing full-fixture triangular solve operands" OFF)
option(ILLIXR_DIAGNOSTIC_KERNEL_FENCE_AB "Compare fences at the internal RVV GEMM return boundary" OFF)
option(ILLIXR_DIAGNOSTIC_KERNEL_DELAY_AB "Compare internal GEMM fence against delay-only return paths" OFF)
if(ILLIXR_DIAGNOSTIC_KERNEL_DELAY_AB)
  if(NOT ILLIXR_DIAGNOSTIC_KERNEL_FENCE_AB)
    message(FATAL_ERROR "Kernel delay A/B requires the kernel fence diagnostic")
  endif()
  target_compile_definitions(app PRIVATE ILLIXR_DIAGNOSTIC_KERNEL_DELAY_AB=1)
endif()
if(ILLIXR_DIAGNOSTIC_KERNEL_FENCE_AB)
  if(NOT ILLIXR_DIAGNOSTIC_BLAS_AB)
    message(FATAL_ERROR "Kernel fence A/B requires the full BLAS runtime A/B fixture")
  endif()
  target_compile_definitions(app PRIVATE ILLIXR_DIAGNOSTIC_KERNEL_FENCE_AB=1)
endif()
if(ILLIXR_DIAGNOSTIC_TRSM_CAPTURE)
  if(NOT ILLIXR_DIAGNOSTIC_BLAS_AB)
    message(FATAL_ERROR "TRSM capture requires the full runtime A/B fixture")
  endif()
  target_compile_definitions(app PRIVATE ILLIXR_DIAGNOSTIC_TRSM_CAPTURE=1)
endif()
if(ILLIXR_DIAGNOSTIC_RVV_REJECT)
  if(NOT ILLIXR_DIAGNOSTIC_RVV_FOCUSED)
    message(FATAL_ERROR "Rejected-vector diagnostic requires focused fixtures")
  endif()
  target_sources(app PRIVATE tests/rvv_focused/rejected.S)
  target_compile_definitions(app PRIVATE ILLIXR_DIAGNOSTIC_RVV_REJECT=1)
endif()
if(ILLIXR_DIAGNOSTIC_RVV_FOCUSED)
  if(NOT ILLIXR_LINALG_BACKEND STREQUAL "openblas_rvv" OR ILLIXR_DIAGNOSTIC_BLAS_AB)
    message(FATAL_ERROR "Focused RVV diagnostic requires RVV BLAS and disables the full A/B fixture")
  endif()
  target_sources(app PRIVATE tests/rvv_focused/focused.cpp tests/rvv_focused/active.S)
  target_compile_definitions(app PRIVATE ILLIXR_DIAGNOSTIC_RVV_FOCUSED=1)
endif()
if(ILLIXR_DIAGNOSTIC_BLAS_AB)
  if(NOT ILLIXR_DIAGNOSTIC_BLAS_PROGRESS OR ILLIXR_DIAGNOSTIC_BLAS_IRQ_MASK)
    message(FATAL_ERROR "BLAS A/B requires progress and controls IRQ masking at runtime")
  endif()
  target_compile_definitions(app PRIVATE ILLIXR_DIAGNOSTIC_BLAS_AB=1)
endif()
if(ILLIXR_DIAGNOSTIC_BLAS_IRQ_MASK)
  if(NOT ILLIXR_DIAGNOSTIC_BLAS_PROGRESS)
    message(FATAL_ERROR "BLAS IRQ masking is diagnostic-only and requires progress instrumentation")
  endif()
  target_compile_definitions(app PRIVATE ILLIXR_DIAGNOSTIC_BLAS_IRQ_MASK=1)
endif()
if(ILLIXR_DIAGNOSTIC_BLAS_PROGRESS)
  target_compile_definitions(app PRIVATE ILLIXR_DIAGNOSTIC_BLAS_PROGRESS=1)
endif()
option(ILLIXR_DIAGNOSTIC_IMAGE_ADDRESS "Observe image coordinates and ROI addresses" OFF)
option(ILLIXR_DIAGNOSTIC_IMAGE_ARITHMETIC "Replay captured scalar image-coordinate arithmetic" OFF)
option(ILLIXR_DIAGNOSTIC_FPU_TRAP "Verify rejected FP divides have no register side effects" OFF)
if(ILLIXR_DIAGNOSTIC_FPU_TRAP)
  target_sources(app PRIVATE tests/image_address/trap.cpp tests/image_address/trap.S)
  target_compile_definitions(app PRIVATE ILLIXR_DIAGNOSTIC_FPU_TRAP=1)
endif()
option(ILLIXR_DIAGNOSTIC_FPU_BARRIER "A/B test FCSR serialization before FPU exception entry" OFF)
if(ILLIXR_DIAGNOSTIC_FPU_BARRIER)
  if(NOT ILLIXR_DIAGNOSTIC_IMAGE_ARITHMETIC)
    message(FATAL_ERROR "FPU barrier A/B diagnostic requires the image arithmetic fixture")
  endif()
  target_sources(app PRIVATE tests/image_address/fpu_barrier.S)
  target_compile_definitions(app PRIVATE ILLIXR_DIAGNOSTIC_FPU_BARRIER=1)
  zephyr_ld_options("-Wl,--wrap=z_riscv_fpu_enter_exc")
endif()
if(ILLIXR_DIAGNOSTIC_IMAGE_ARITHMETIC)
  target_sources(app PRIVATE tests/image_address/arithmetic.cpp tests/image_address/arithmetic.S)
  target_compile_definitions(app PRIVATE ILLIXR_DIAGNOSTIC_IMAGE_ARITHMETIC=1)
endif()
if(ILLIXR_DIAGNOSTIC_FAULTS)
  target_sources(app PRIVATE src/fault_diagnostics.cpp)
  zephyr_ld_options("-Wl,--wrap=z_riscv_fault")
endif()
if(ILLIXR_DIAGNOSTIC_RAW_TRAP)
  if(ILLIXR_DIAGNOSTIC_FAULTS)
    message(FATAL_ERROR "Select only one fatal diagnostic implementation")
  endif()
  target_sources(app PRIVATE src/raw_trap_diagnostics.cpp)
  zephyr_ld_options("-Wl,--wrap=z_riscv_fault" "-Wl,--wrap=z_riscv_fatal_error"
                    "-Wl,--wrap=z_fatal_error")
endif()


# ============================================================
# === Global toolchain / cross-compile settings (for OpenCV) ==
# ============================================================

# Make OpenCV's try_compile not attempt to run executables
set(CMAKE_TRY_COMPILE_TARGET_TYPE STATIC_LIBRARY CACHE STRING "" FORCE)

# ============================================================
# === Top-level path anchors ================================
# ============================================================

# Zephyr repo root (…/zephyr_ws/zephyr) is in ZEPHYR_BASE.
# Define a stable workspace top one level above it.
get_filename_component(ZEPHYR_TOP "${ZEPHYR_BASE}" DIRECTORY)

# This Zephyr variable is the root of your application (illixr_working).
# (Zephyr sets it; we fall back safely if needed.)
if(NOT DEFINED APPLICATION_SOURCE_DIR)
  set(APPLICATION_SOURCE_DIR "${CMAKE_CURRENT_SOURCE_DIR}")
endif()

message(STATUS "ZEPHYR_BASE            = ${ZEPHYR_BASE}")
message(STATUS "ZEPHYR_TOP             = ${ZEPHYR_TOP}")
message(STATUS "APPLICATION_SOURCE_DIR = ${APPLICATION_SOURCE_DIR}")

# Convenience: absolute path to your helper directory
set(ILLIXR_HELPER_DIR "${APPLICATION_SOURCE_DIR}/src/helper")



# OpenCV's "bitness" detection often fails under Zephyr cross builds
if(NOT DEFINED CMAKE_SIZEOF_VOID_P)
  set(CMAKE_SIZEOF_VOID_P 8 CACHE STRING "Pointer size" FORCE)
endif()

set(CMAKE_CXX_STANDARD 20)
set(CMAKE_CXX_STANDARD_REQUIRED ON)

# ============================================================
# === RISC-V flags (apply to EVERYTHING: app + plugins + OpenCV)
# ============================================================

set(RV64_FLAGS -march=rv64imafdc_zicsr_zifencei -mabi=lp64d)

# Apply globally so subprojects (OpenCV) inherit them
add_compile_options(${RV64_FLAGS})
add_link_options(${RV64_FLAGS})

# ============================================================
# === OpenCV: build from source once at top-level ============
# ============================================================

# Path to OpenCV source
set(OPENCV_SRC_DIR "" CACHE PATH "Pinned OpenCV 4.5.4 source tree")
if(NOT EXISTS "${OPENCV_SRC_DIR}/CMakeLists.txt")
  message(FATAL_ERROR "Set OPENCV_SRC_DIR to the OpenCV 4.5.4 source checkout")
endif()
set(ILLIXR_DATASET_DIR "" CACHE PATH "EuRoC mav0 input directory")
set(ILLIXR_DATASET_FRAMES 50 CACHE STRING "Number of embedded stereo pairs")
set(ILLIXR_DATA_INCLUDE_DIR "${CMAKE_BINARY_DIR}/generated" CACHE PATH "Generated embedded dataset headers")
set(ILLIXR_CAM_QUEUE_CAPACITY 8 CACHE STRING "Pending stereo frames")
set(ILLIXR_IMU_QUEUE_CAPACITY 4096 CACHE STRING "IMU records per subscriber")
set(ILLIXR_VIO_DELAY_MS 0 CACHE STRING "One-time VIO delay for overload testing")
set(ILLIXR_VIO_DELAY_AFTER_CAM 1 CACHE STRING "Processed camera count before test delay")
option(ILLIXR_PIN_PLUGINS "Use fixed per-plugin CPU affinity" OFF)
option(ILLIXR_PLATFORM_CHECK_ONLY "Exit after hart, atomic and timer checks" OFF)
option(ILLIXR_BATCH_TRACE "Export deferred trace records through batched HTIF writes" ON)
add_compile_definitions(ILLIXR_BATCH_TRACE=$<BOOL:${ILLIXR_BATCH_TRACE}>)
set(ILLIXR_CORE_HZ 0 CACHE STRING "Hardware core clock for timer-ratio validation; zero skips ratio check")
set(ILLIXR_DISPLAY_HZ 120 CACHE STRING "Simulated display refresh rate")
set(ILLIXR_RENDER_DELAY_NS 6944445 CACHE STRING "Asynchronous render latency in target nanoseconds")
set(ILLIXR_TIMEWARP_DELAY_NS 1000000 CACHE STRING "Asynchronous timewarp latency in target nanoseconds")
set(ILLIXR_RENDER_OFFSET_NS 1000000 CACHE STRING "Render start offset after vsync")
set(ILLIXR_TIMEWARP_MARGIN_NS 1000000 CACHE STRING "Timewarp scheduling margin before GPU work")
target_compile_definitions(app PRIVATE
  ILLIXR_PIN_PLUGINS=$<BOOL:${ILLIXR_PIN_PLUGINS}>
  ILLIXR_PLATFORM_CHECK_ONLY=$<BOOL:${ILLIXR_PLATFORM_CHECK_ONLY}>
  ILLIXR_CORE_HZ=${ILLIXR_CORE_HZ})
# Keep neutral definitions stable for third-party objects across replay tests.
# Only queue-owning plugins override these knobs; producers use k_msgq metadata.
add_compile_definitions(
  ILLIXR_CAM_QUEUE_CAPACITY=8
  ILLIXR_IMU_QUEUE_CAPACITY=4096
  ILLIXR_VIO_DELAY_MS=0
  ILLIXR_VIO_DELAY_AFTER_CAM=1)
function(illixr_replay_overrides target)
  set(default_ILLIXR_CAM_QUEUE_CAPACITY 8)
  set(default_ILLIXR_IMU_QUEUE_CAPACITY 4096)
  set(default_ILLIXR_VIO_DELAY_MS 0)
  set(default_ILLIXR_VIO_DELAY_AFTER_CAM 1)
  foreach(knob ILLIXR_CAM_QUEUE_CAPACITY ILLIXR_IMU_QUEUE_CAPACITY
               ILLIXR_VIO_DELAY_MS ILLIXR_VIO_DELAY_AFTER_CAM)
    if(NOT "${${knob}}" STREQUAL "${default_${knob}}")
      target_compile_options(${target} PRIVATE "-U${knob}" "-D${knob}=${${knob}}")
    endif()
  endforeach()
endfunction()
include_directories("${ILLIXR_DATA_INCLUDE_DIR}")
add_custom_command(
  OUTPUT "${ILLIXR_DATA_INCLUDE_DIR}/embedded_imu.hpp"
         "${ILLIXR_DATA_INCLUDE_DIR}/embedded_cam.hpp"
         "${ILLIXR_DATA_INCLUDE_DIR}/embedded_dataset.hpp"
         "${ILLIXR_DATA_INCLUDE_DIR}/dataset_manifest.json"
  COMMAND ${PYTHON_EXECUTABLE} "${CMAKE_CURRENT_SOURCE_DIR}/plugins/openvins/embed_euroc_data.py"
          "${ILLIXR_DATASET_DIR}" "${ILLIXR_DATA_INCLUDE_DIR}" ${ILLIXR_DATASET_FRAMES}
  DEPENDS "${CMAKE_CURRENT_SOURCE_DIR}/plugins/openvins/embed_euroc_data.py"
          "${ILLIXR_DATASET_DIR}/imu0/data.csv"
          "${ILLIXR_DATASET_DIR}/cam0/data.csv"
          "${ILLIXR_DATASET_DIR}/cam1/data.csv"
  COMMENT "Embedding bounded EuRoC dataset" VERBATIM)
add_custom_target(generate_dataset DEPENDS
  "${ILLIXR_DATA_INCLUDE_DIR}/embedded_imu.hpp"
  "${ILLIXR_DATA_INCLUDE_DIR}/embedded_cam.hpp"
  "${ILLIXR_DATA_INCLUDE_DIR}/embedded_dataset.hpp"
  "${ILLIXR_DATA_INCLUDE_DIR}/dataset_manifest.json")
add_dependencies(app generate_dataset)

# If your OpenCV needs linker script fragments, apply at top-level (final link)
zephyr_linker_sources(SECTIONS
  ${CMAKE_CURRENT_SOURCE_DIR}/plugins/opencv/src/custom.ld
)

# OpenCV build options (static + minimal; matches your working cmake)
set(BUILD_opencv_apps OFF CACHE BOOL "" FORCE)
set(BUILD_opencv_version OFF CACHE BOOL "" FORCE)
set(OPENCV_BUILD_APP_LIST "" CACHE STRING "" FORCE)
set(BUILD_SHARED_LIBS OFF CACHE BOOL "" FORCE)
set(BUILD_opencv_world OFF CACHE BOOL "" FORCE)

option(OPENCV_BUILD_HIGHGUI "Enable building opencv_highgui module (desktop only)" OFF)
set(OPENCV_DEFAULT_BUILD_LIST "core,imgproc,imgcodecs")

if(OPENCV_BUILD_HIGHGUI)
  set(BUILD_LIST "${OPENCV_DEFAULT_BUILD_LIST},highgui" CACHE STRING "" FORCE)
  set(BUILD_opencv_highgui ON CACHE BOOL "" FORCE)
else()
  set(BUILD_LIST "${OPENCV_DEFAULT_BUILD_LIST}" CACHE STRING "" FORCE)
  set(BUILD_opencv_highgui OFF CACHE BOOL "" FORCE)
endif()

set(BUILD_TESTS OFF CACHE BOOL "" FORCE)
set(BUILD_PERF_TESTS OFF CACHE BOOL "" FORCE)
set(BUILD_EXAMPLES OFF CACHE BOOL "" FORCE)
set(BUILD_DOCS OFF CACHE BOOL "" FORCE)

foreach(feature OPENCL OPENCLAMDFFT OPENCLAMDBLAS IPP ITT TBB OPENMP LAPACK PROTOBUF
                QUIRC WEBP GDCM V4L FFMPEG GSTREAMER GTK QT CAROTENE)
  set(WITH_${feature} OFF CACHE BOOL "" FORCE)
endforeach()
set(OPENCV_ENABLE_NONFREE OFF CACHE BOOL "" FORCE)
set(OPENCV_GENERATE_PKGCONFIG OFF CACHE BOOL "" FORCE)
set(ENABLE_PRECOMPILED_HEADERS OFF CACHE BOOL "" FORCE)
set(CV_ENABLE_INTRINSICS OFF CACHE BOOL "" FORCE)

set(CPU_BASELINE "" CACHE STRING "" FORCE)
set(CPU_DISPATCH "" CACHE STRING "" FORCE)
set(WITH_TIFF OFF CACHE BOOL "" FORCE)
set(BUILD_TIFF OFF CACHE BOOL "" FORCE)
set(WITH_OPENEXR OFF CACHE BOOL "" FORCE)
set(WITH_JASPER OFF CACHE BOOL "" FORCE)
set(WITH_ADE OFF CACHE BOOL "" FORCE)
set(BUILD_ADE OFF CACHE BOOL "" FORCE)

set(OPENCV_FORCE_3RDPARTY_BUILD ON CACHE BOOL "" FORCE)
set(BUILD_ZLIB ON CACHE BOOL "" FORCE)
set(BUILD_PNG ON CACHE BOOL "" FORCE)
set(BUILD_JPEG ON CACHE BOOL "" FORCE)
set(WITH_OPENJPEG OFF CACHE BOOL "" FORCE)
set(BUILD_OPENJPEG OFF CACHE BOOL "" FORCE)

# Bare-metal: no pthread support
set(OPENCV_DISABLE_THREAD_SUPPORT ON CACHE BOOL "" FORCE)
set(WITH_PTHREADS_PF OFF CACHE BOOL "" FORCE)
set(OPENCV_DISABLE_PTHREADS_PF ON CACHE BOOL "" FORCE)

# IMPORTANT:
# Keep these as GLOBAL compile definitions so OpenCV subproject sees them
add_compile_definitions(
  OPENCV_DISABLE_THREAD_SUPPORT
  OPENCV_DISABLE_PTHREADS_PF
  M_PI=3.14159265358979323846
  M_E=2.71828182845904523536
)

# Build OpenCV in the main build tree
add_subdirectory(${OPENCV_SRC_DIR} ${CMAKE_CURRENT_BINARY_DIR}/opencv_build)

# SDK GCC 12 emits __atomic_exchange_1 and ships no libatomic.
# One ABI-correct, sequentially consistent LR/SC fallback supplies it.
target_sources(app PRIVATE plugins/opencv/src/atomic_shim.c)
foreach(cv_target opencv_core opencv_imgproc opencv_imgcodecs zlib libpng libjpeg-turbo)
  if(TARGET ${cv_target})
    set_property(TARGET ${cv_target} APPEND PROPERTY LINK_LIBRARIES zephyr_interface)
  endif()
endforeach()
foreach(cv_target opencv_core opencv_imgproc opencv_imgcodecs)
  target_compile_options(${cv_target} PRIVATE
    "SHELL:-include ${CMAKE_CURRENT_SOURCE_DIR}/plugins/opencv/src/zephyr_compat.hpp")
endforeach()

# ============================================================
# === OpenCV bundle target used by app + plugins =============
# ============================================================

add_library(illixr_opencv INTERFACE)

# Anything linking illixr_opencv gets these include dirs and libs
set(OPENCV_BIN_DIR ${CMAKE_CURRENT_BINARY_DIR}/opencv_build)

target_include_directories(illixr_opencv INTERFACE
  ${OPENCV_BIN_DIR}/include          # <--- THIS is the big missing one
  ${CMAKE_CURRENT_BINARY_DIR}        # <--- covers build/opencv2 (seen in your tree)
  ${OPENCV_SRC_DIR}/modules/core/include
  ${OPENCV_SRC_DIR}/modules/imgproc/include
  ${OPENCV_SRC_DIR}/modules/imgcodecs/include
)

target_link_libraries(illixr_opencv INTERFACE
  -Wl,--start-group
  opencv_core
  opencv_imgproc
  opencv_imgcodecs
  -Wl,--end-group
)

if(OPENCV_BUILD_HIGHGUI)
  target_link_libraries(illixr_opencv INTERFACE opencv_highgui)
endif()

# Make OpenCV available to non-plugin app code too
target_link_libraries(app PRIVATE illixr_opencv)
target_include_directories(app PRIVATE "${CMAKE_CURRENT_SOURCE_DIR}/src" "${ZEPHYR_BASE}/../modules/lib/eigen")
target_compile_options(app PRIVATE
  "$<$<COMPILE_LANGUAGE:CXX>:SHELL:-include ${ILLIXR_HELPER_DIR}/opencv_helper.hpp>"
  "$<$<COMPILE_LANGUAGE:CXX>:SHELL:-include ${ILLIXR_HELPER_DIR}/eigen_lib_fix.hpp>")
target_sources(app PRIVATE plugins/opencv/src/zephyr_support.cpp)

# ============================================================
# === YAML CONFIG PARSING ====================================
# ============================================================

if (NOT DEFINED YAML_FILE)
  message(FATAL_ERROR "You must pass: -DYAML_FILE=<path_to_yaml>")
endif()

get_filename_component(YAML_FILE "${YAML_FILE}" ABSOLUTE)
message(STATUS "Using YAML_FILE: ${YAML_FILE}")

set(READ_YAML_SCRIPT "${CMAKE_CURRENT_SOURCE_DIR}/read_yaml.py")
set(GENERATED_CONFIG "${CMAKE_CURRENT_BINARY_DIR}/generated_config.hpp")

add_custom_command(
  OUTPUT ${GENERATED_CONFIG}
  COMMAND ${PYTHON_EXECUTABLE} ${READ_YAML_SCRIPT} ${YAML_FILE} ${GENERATED_CONFIG}
  DEPENDS ${READ_YAML_SCRIPT} ${YAML_FILE}
  COMMENT "Parsing YAML and generating ${GENERATED_CONFIG}"
)

add_custom_target(generate_yaml ALL DEPENDS ${GENERATED_CONFIG})
add_dependencies(app generate_yaml)
target_include_directories(app PRIVATE ${CMAKE_CURRENT_BINARY_DIR})

# ============================================================
# === CORE SOURCE FILES ======================================
# ============================================================

option(ILLIXR_ESTIMATOR_REPLAY "Isolated fixed-order Spike estimator test" OFF)
if(ILLIXR_ESTIMATOR_REPLAY)
  if(NOT BOARD STREQUAL "spike_riscv64")
    message(FATAL_ERROR "Streamed estimator replay is Spike-only")
  endif()
  set(ILLIXR_ESTIMATOR_INPUT "" CACHE FILEPATH "Test input stream")
  set(ILLIXR_ESTIMATOR_OUTPUT "" CACHE FILEPATH "Test output state stream")
  if(NOT ILLIXR_ESTIMATOR_INPUT OR NOT ILLIXR_ESTIMATOR_OUTPUT)
    message(FATAL_ERROR "Explicit estimator stream paths required")
  endif()
  add_compile_definitions(ILLIXR_ESTIMATOR_REPLAY=1 ILLIXR_ESTIMATOR_INPUT="${ILLIXR_ESTIMATOR_INPUT}" ILLIXR_ESTIMATOR_OUTPUT="${ILLIXR_ESTIMATOR_OUTPUT}")
  execute_process(COMMAND "${PYTHON_EXECUTABLE}" "${CMAKE_CURRENT_SOURCE_DIR}/tests/native/extract_config.py" "${CMAKE_CURRENT_SOURCE_DIR}" "${CMAKE_CURRENT_BINARY_DIR}/estimator_config" COMMAND_ERROR_IS_FATAL ANY)
  target_include_directories(app PRIVATE "${CMAKE_CURRENT_SOURCE_DIR}/plugins/openvins" "${CMAKE_CURRENT_BINARY_DIR}/estimator_config")
  set(ILLIXR_MAIN tests/estimator_spike/main.cpp)
else()
  set(ILLIXR_MAIN src/main.cpp)
endif()
target_sources(app PRIVATE
  ${ILLIXR_MAIN}
  src/trace_transport.cpp
  src/node.cpp
  src/relative_clock.cpp
  src/phonebook_new.cpp
  src/stoplight.cpp
)

# ============================================================
# === Restore Zephyr output paths (OpenCV can mess with them) =
# ============================================================

set_target_properties(zephyr_final PROPERTIES
  RUNTIME_OUTPUT_DIRECTORY "${CMAKE_BINARY_DIR}/zephyr"
  OUTPUT_NAME "zephyr"
)

if(TARGET zephyr_prebuilt)
  set_target_properties(zephyr_prebuilt PROPERTIES
    RUNTIME_OUTPUT_DIRECTORY "${CMAKE_BINARY_DIR}/zephyr"
  )
endif()

# Ensure Zephyr post-build scripts look for zephyr/zephyr.elf
set(KERNEL_ELF_NAME zephyr.elf CACHE INTERNAL "" FORCE)


# ============================================================
# === READ YAML AND LOAD PLUGIN NAMES ========================
# ============================================================

file(READ "${YAML_FILE}" YAML_CONTENTS)
string(REGEX MATCH "plugins:[ \t]*([^\n\r]+)" PLUGIN_LINE "${YAML_CONTENTS}")

if(PLUGIN_LINE)
  string(REGEX REPLACE "plugins:[ \t]*" "" PLUGIN_LIST_RAW "${PLUGIN_LINE}")
  string(REPLACE "," ";" PLUGIN_NAMES "${PLUGIN_LIST_RAW}")

  set(PLUGIN_NAMES_CLEAN "")
  foreach(P IN LISTS PLUGIN_NAMES)
    string(STRIP "${P}" P_STRIPPED)
    if(P_STRIPPED)
      list(APPEND PLUGIN_NAMES_CLEAN "${P_STRIPPED}")
    endif()
  endforeach()

  message(STATUS "Resolved plugins: ${PLUGIN_NAMES_CLEAN}")

  if("render_loop" IN_LIST PLUGIN_NAMES_CLEAN)
    if(NOT "pose_prediction" IN_LIST PLUGIN_NAMES_CLEAN OR NOT "timewarp" IN_LIST PLUGIN_NAMES_CLEAN)
      message(FATAL_ERROR "The GPU pipeline requires pose_prediction, render_loop and timewarp")
    endif()
    add_compile_definitions(ILLIXR_GPU_PIPELINE=1)
    add_compile_definitions(
      ILLIXR_DISPLAY_HZ=${ILLIXR_DISPLAY_HZ}
      ILLIXR_RENDER_DELAY_NS=${ILLIXR_RENDER_DELAY_NS}
      ILLIXR_TIMEWARP_DELAY_NS=${ILLIXR_TIMEWARP_DELAY_NS}
      ILLIXR_RENDER_OFFSET_NS=${ILLIXR_RENDER_OFFSET_NS}
      ILLIXR_TIMEWARP_MARGIN_NS=${ILLIXR_TIMEWARP_MARGIN_NS})
  else()
    add_compile_definitions(ILLIXR_GPU_PIPELINE=0)
  endif()

  set(ILLIXR_EYE_TRACKING_ENABLED OFF CACHE INTERNAL "Eye plugins compiled into this firmware" FORCE)
  if("eye_tracking" IN_LIST PLUGIN_NAMES_CLEAN OR "offline_eye" IN_LIST PLUGIN_NAMES_CLEAN)
    if(NOT "eye_tracking" IN_LIST PLUGIN_NAMES_CLEAN OR NOT "offline_eye" IN_LIST PLUGIN_NAMES_CLEAN OR NOT "timewarp" IN_LIST PLUGIN_NAMES_CLEAN)
      message(FATAL_ERROR "Eye tracking requires offline_eye, eye_tracking, and timewarp")
    endif()
    if(NOT ILLIXR_DISPLAY_HZ EQUAL 120)
      message(FATAL_ERROR "The eye workload uses the agreed 120 Hz publication rate")
    endif()
    set(ILLIXR_EYE_TRACKING_ENABLED ON CACHE INTERNAL "Eye plugins compiled into this firmware" FORCE)
    add_compile_definitions(ILLIXR_EYE_TRACKING=1)
    include(cmake/illixr_ritnet.cmake)
    target_sources(app PRIVATE src/eye_tracking.cpp)
  endif()

  foreach(P IN LISTS PLUGIN_NAMES_CLEAN)
    set(PLUGIN_DIR "${CMAKE_CURRENT_SOURCE_DIR}/plugins/${P}")
    message(STATUS "Adding plugin '${P}' from ${PLUGIN_DIR}")

    add_subdirectory("${PLUGIN_DIR}" "${CMAKE_CURRENT_BINARY_DIR}/plugins/${P}")

    if(TARGET ${P})
      target_compile_definitions(${P} PRIVATE ILLIXR_PIN_PLUGINS=$<BOOL:${ILLIXR_PIN_PLUGINS}>)
      if(P STREQUAL "openvins" OR P STREQUAL "imu_integrator")
        illixr_replay_overrides(${P})
      endif()
      add_dependencies(${P} generate_dataset)
      target_sources(app PRIVATE $<TARGET_OBJECTS:${P}>)
      message(STATUS "Added plugin '${P}' object files into app")
    else()
      message(WARNING "Plugin '${P}' did not define target '${P}'")
    endif()
  endforeach()
endif()
```

## prj.conf
```kconfig
# Full C++ runtime and statically linked OpenCV.
CONFIG_NEWLIB_LIBC=y
CONFIG_NEWLIB_LIBC_NANO=n
CONFIG_PICOLIBC=n
CONFIG_REQUIRES_FULL_LIBCPP=y
CONFIG_CPP=y
CONFIG_STD_CPP20=y
CONFIG_GLIBCXX_LIBCPP=y
CONFIG_CPP_EXCEPTIONS=y
CONFIG_CPP_RTTI=y
CONFIG_GNU_C_EXTENSIONS=y
CONFIG_HEAP_MEM_POOL_SIZE=1048576
CONFIG_COMMON_LIBC_MALLOC=y
CONFIG_COMMON_LIBC_MALLOC_ARENA_SIZE=67108864
CONFIG_THREAD_STACK_MEM_MAPPED=n
CONFIG_POSIX_API=y
CONFIG_POSIX_THREADS=y
CONFIG_MULTITHREADING=y
CONFIG_DYNAMIC_THREAD=y
CONFIG_DYNAMIC_THREAD_ALLOC=y
CONFIG_FPU=y
CONFIG_FPU_SHARING=y
CONFIG_RISCV_ISA_EXT_V=n
CONFIG_MAIN_STACK_SIZE=1048576
CONFIG_ISR_STACK_SIZE=8192
CONFIG_IDLE_STACK_SIZE=4096
CONFIG_THREAD_NAME=y
CONFIG_THREAD_MONITOR=y
CONFIG_TIMESLICING=y
CONFIG_TIMESLICE_SIZE=1
CONFIG_SYS_CLOCK_TICKS_PER_SEC=10000
CONFIG_LOG=y
CONFIG_ASSERT=y
CONFIG_THREAD_LOCAL_STORAGE=y
CONFIG_NEWLIB_LIBC_FLOAT_PRINTF=y
CONFIG_SPEED_OPTIMIZATIONS=y
```

## src/main.cpp
```c
#include "hpm.hpp"
#include "blas_backend.hpp"
#ifdef ILLIXR_EYE_TRACKING
#include "eye_tracking.hpp"
#endif
#include "vector_check.hpp"
#include "../plugins/imu_integrator/imu_integrator_queue.hpp"
#include "../plugins/openvins/openvins_queues.hpp"
#include "clock_check.hpp"
#include "data_format_opencv.hpp"
#include "phonebook_new.hpp"
#include "runtime.hpp"
#if ILLIXR_GPU_PIPELINE
#include "gpu_pipeline.hpp"
#include "pose_prediction.hpp"
#endif
#include <cstdio>
#include <zephyr/kernel.h>
#include <zephyr/logging/log_ctrl.h>

#ifndef ILLIXR_PLATFORM_CHECK_ONLY
#define ILLIXR_PLATFORM_CHECK_ONLY 0
#endif

extern "C" {
extern volatile uint64_t tohost;
extern volatile uint64_t fromhost;
}
static void simulator_exit(int code) {
  fflush(stdout);
  // HTIF device 0, command 0. Wait for the console's previous transaction.
  while (tohost) {
    k_yield();
  }
  __asm__ volatile("fence rw,rw" ::: "memory");
  tohost = (static_cast<uint64_t>(code) << 1) | 1;
  for (;;) {
    __asm__ volatile("wfi");
  }
}
int main() {
  using namespace ILLIXR;

  // Drain the deferred boot banner before emitting machine-readable records.
  log_flush();

  // initialize tracing system (initializes a mutex to protext trace queue)
  replay::initialize();

#if ILLIXR_GPU_PIPELINE
  // initialize GPU image and mutexes
  gpu_pipeline::initialize();
#endif

  // controlled multi-core testing to ensure all harts are online and functioning correctly
  const auto online_harts = clock_check::run();

  // check that the platform hardware timer and clock frequency are aligned
  clock_check::platform(online_harts);

#ifdef ILLIXR_DIAGNOSTIC_FPU_TRAP
  extern bool image_fpu_trap_check_entry();
  if (!image_fpu_trap_check_entry()) replay::fail("faulting FP divide modified its destination");
#endif
#ifdef ILLIXR_DIAGNOSTIC_IMAGE_ARITHMETIC
  extern bool image_arithmetic_check_entry();
  if (!image_arithmetic_check_entry()) replay::fail("image arithmetic preflight failed");
#endif

  // prepare selected linalg backend for use 
  blas_backend::initialize();

  // check vector unit functionality
  if (!vector_check::run()) replay::fail("vector context preflight failed");
  
  // check BLAS backend functionality
  if (!replay::failed() && !blas_backend::self_test()) replay::fail("BLAS self-test failed");
  
  // exit if backend checks failed 
  if (!replay::failed() && !hpm::initialize()) replay::fail("HPM preflight failed");
  if (ILLIXR_PLATFORM_CHECK_ONLY) {
    printf("ILLIXR_DIAGNOSTIC %s\n", replay::failure_reason);
    simulator_exit(replay::failed() ? 1 : 0);
  }
  
  // create Phonebook instance 
  init_phonebook_global();
  auto &pb = get_phonebook();

  Runtime runtime{pb};
  int64_t runtime_ns = 0;
  if (!replay::failed()) {

    // start all registered plugins
    runtime.start_all_plugins();

    // set up the observation schedule. A period is ~8.33 ms corresponding to 120 Hz display
    constexpr int64_t period_ns = 1000000000LL / 120;
    int64_t deadline = 0;

    // 120 Hz display loop:
    // continue while workers remain active and no failures have occurred
    auto &clock = get_global_relative_clock();
    while (!runtime.finished() && !replay::failed()) {

      // read latest VIO and propagated pose snapshots, validates them, updates stats, records trace entry
      replay::observe_pose();
#if ILLIXR_GPU_PIPELINE
      // record which timewarp output would have been shown at each display refresh boundary
      gpu_pipeline::observe_display(replay::hart_id());
#endif
      // calculate next deadline and skip elapsed observation slots
      // if main has fallen behind, we move to first strictly failure slot 
      deadline += period_ns;
      const auto now = clock.now_ns();
      if (deadline <= now) {
        const auto missed = (now - deadline) / period_ns + 1;
        replay::count(replay::PROBE_MISSED, missed);
        deadline += missed * period_ns;
      }
      // sleep until that absolute deadline
      k_sleep(K_TIMEOUT_ABS_TICKS(clock.absolute_ticks(deadline)));
    }
    runtime.shutdown();
#if ILLIXR_GPU_PIPELINE
    if (!replay::failed()) gpu_pipeline::finish_presentation(replay::hart_id());
#endif
    runtime_ns = clock.now_ns();
  }

  // shutdown runtime, export results

#ifdef ILLIXR_EYE_TRACKING
  eye_tracking::shutdown();
  if (get_global_relative_clock().is_started())
    runtime_ns = get_global_relative_clock().now_ns();
#endif
  hpm::stop();
  // After every producer has joined it is safe to reclaim residual failure-path
  // records.
  CamMsg *cam = nullptr;
  k_msgq_purge(&openvins_imu_queue);
  k_msgq_purge(&imu_integrator_queue);
  while (k_msgq_get(&openvins_cam_queue, &cam, K_NO_WAIT) == 0)
    delete cam;
  using namespace replay;
  if (!failed() && (value(IMU_PUBLISHED) != value(IMU_VIO) ||
                    value(IMU_PUBLISHED) != value(IMU_INTEGRATOR)))
    fail("IMU end-of-stream count mismatch");
  const auto &export_clock = get_global_relative_clock();
  const auto export_start_ns = export_clock.is_started() ? export_clock.now_ns() : 0;
  trace_output::begin();
#if ILLIXR_GPU_PIPELINE
  if (!get_pose_prediction().validate())
    fail("prediction validation failed");
  gpu_pipeline::validate();
  get_pose_prediction().dump();
  gpu_pipeline::dump();
#endif
#ifdef ILLIXR_EYE_TRACKING
  eye_tracking::dump();
#endif
  dump_trace();
  dump_placement();
  hpm::dump();
  blas_backend::dump();
  trace_output::print("ILLIXR_PROPAGATION {\"max_observed_position_norm_m\":%.17g}\n",
         max_observed_propagated_position_norm);
  if (!trace_output::finish()) fail("batched trace export failed");
  const auto export_end_ns = export_clock.is_started() ? export_clock.now_ns() : 0;
  // Only fixed diagnostic strings enter this JSON. Exceptions are printed
  // separately.
  printf("ILLIXR_DIAGNOSTIC %s\n", failure_reason);
  printf("ILLIXR_RESULT "
         "{\"status\":\"%s\",\"origin_ns\":%lld,\"online_harts\":%u,\"imu_"
         "published\":%ld,\"imu_processed\":%ld,"
         "\"imu_integrator_processed\":%ld,\"cam_published\":%ld,\"cam_"
         "processed\":%ld,\"cam_skipped\":%ld,\"cam_"
         "dropped\":%ld,\"imu_overflow\":%ld,\"initialized\":%s,\"vio_poses\":%"
         "ld,\"probe_reads\":%ld,\"probe_"
         "repeated_vio\":%ld,\"probe_imu_advanced\":%ld,\"probe_missed_"
         "deadlines\":%ld,\"trace_overflow\":%ld,\"imu_"
         "vio_highwater\":%ld,\"imu_integrator_highwater\":%ld,\"cam_"
         "highwater\":%ld,\"history_highwater\":%ld,"
         "\"runtime_ns\":%lld,\"trace_export_start_ns\":%lld,\"trace_export_end_ns\":%lld,\"trace_export_ns\":%lld}\n",
         failed() ? "fail" : "pass", (long long)kEmbeddedDatasetOriginNs,
         online_harts, value(IMU_PUBLISHED), value(IMU_VIO),
         value(IMU_INTEGRATOR), value(CAM_PUBLISHED), value(CAM_VIO),
         value(CAM_SKIPPED), value(CAM_DROPPED), value(IMU_OVERFLOW),
         value(VIO_POSES) ? "true" : "false", value(VIO_POSES),
         value(PROBE_READS), value(PROBE_REPEATED_VIO),
         value(PROBE_IMU_ADVANCED), value(PROBE_MISSED), value(TRACE_OVERFLOW),
         value(IMU_VIO_HIGHWATER), value(IMU_INT_HIGHWATER),
         value(CAM_HIGHWATER), value(INTEGRATOR_HISTORY_HIGHWATER),
         (long long)runtime_ns, (long long)export_start_ns, (long long)export_end_ns,
         (long long)(export_end_ns - export_start_ns));
  simulator_exit(failed() ? 1 : 0);
  return 0;
}
```

## src/blas_backend.hpp
```c
#pragma once
namespace ILLIXR::blas_backend {
void initialize();
void dump();
bool self_test();
}
```

## src/blas_reference.cpp
```c
// A separate namespace isolates this Eigen-only numerical oracle from the
// application's BLAS-enabled Eigen instantiations (including inline symbols).
#undef EIGEN_USE_BLAS
#define Eigen IllixrBlasReferenceEigen
#include <Eigen/Core>
#undef Eigen
#include "blas_reference.hpp"
#include <cstdlib>

namespace ILLIXR::blas_reference {
using Matrix = IllixrBlasReferenceEigen::MatrixXd;
using Vector = IllixrBlasReferenceEigen::VectorXd;
static Matrix matrix(const double *a, int rows, int cols, int stride) {
  Matrix result(rows, cols);
  for (int j=0; j<cols; ++j)
    for (int i=0; i<rows; ++i) result(i,j)=a[i+j*stride];
  return result;
}
void gemm(char ta, char tb, int m, int n, int k, double alpha,
          const double *a, int lda, const double *b, int ldb,
          double beta, double *c, int ldc) {
  Matrix left=matrix(a,ta=='N'?m:k,ta=='N'?k:m,lda);
  Matrix right=matrix(b,tb=='N'?k:n,tb=='N'?n:k,ldb);
  if(ta=='T') left.transposeInPlace();
  if(tb=='T') right.transposeInPlace();
  Matrix result=alpha*(left*right)+beta*matrix(c,m,n,ldc);
  for(int j=0;j<n;++j) for(int i=0;i<m;++i) c[i+j*ldc]=result(i,j);
}
void gemv(char transpose, int m, int n, double alpha, const double *a,
          int lda, const double *x, int inc, double beta, double *y) {
  Matrix mat=matrix(a,m,n,lda);
  if(transpose=='T') mat.transposeInPlace();
  const int nx=mat.cols(),ny=mat.rows();
  const int x0=inc<0?(nx-1)*std::abs(inc):0;
  const int y0=inc<0?(ny-1)*std::abs(inc):0;
  Vector input(nx),output(ny);
  for(int i=0;i<nx;++i) input(i)=x[x0+i*inc];
  for(int i=0;i<ny;++i) output(i)=y[y0+i*inc];
  output=alpha*(mat*input)+beta*output;
  for(int i=0;i<ny;++i) y[y0+i*inc]=output(i);
}
void triangular(char side, char uplo, char transpose, char diagonal,
                int m, int n, double alpha, const double *a, int lda,
                double *b, int ldb) {
  const int order=side=='L'?m:n;
  Matrix mat=matrix(a,order,order,lda),input=matrix(b,m,n,ldb);
  for(int j=0;j<order;++j) for(int i=0;i<order;++i) {
    if((uplo=='U' && i>j)||(uplo=='L' && i<j)) mat(i,j)=0.;
    if(diagonal=='U' && i==j) mat(i,j)=1.;
  }
  if(transpose=='T') mat.transposeInPlace();
  Matrix result;
  if(side=='L') result=alpha*(mat*input);
  else result=alpha*(input*mat);
  for(int j=0;j<n;++j) for(int i=0;i<m;++i) b[i+j*ldb]=result(i,j);
}
}
```

## src/blas_reference.hpp
```c
#pragma once

// Test oracle only; plain-pointer ABI prevents sharing Eigen definitions with
// application translation units compiled with EIGEN_USE_BLAS.
namespace ILLIXR::blas_reference {
void gemm(char ta, char tb, int m, int n, int k, double alpha,
          const double *a, int lda, const double *b, int ldb,
          double beta, double *c, int ldc);
void gemv(char transpose, int m, int n, double alpha, const double *a,
          int lda, const double *x, int inc, double beta, double *y);
void triangular(char side, char uplo, char transpose, char diagonal,
                int m, int n, double alpha, const double *a, int lda,
                double *b, int ldb);
}
```

## src/clock_check.hpp
```c
#pragma once
#include "replay.hpp"
#include <zephyr/kernel.h>

#ifndef ILLIXR_CORE_HZ
#define ILLIXR_CORE_HZ 0
#endif

namespace ILLIXR::clock_check {
inline constexpr unsigned cpu_count = CONFIG_MP_MAX_NUM_CPUS;
inline constexpr unsigned test_workers = cpu_count < 2 ? 2 : cpu_count;
K_THREAD_STACK_ARRAY_DEFINE(stacks, test_workers, 4096);
inline k_thread threads[test_workers];
inline k_sem turns[test_workers];
inline LatestValue<uint64_t> mailbox;
inline atomic_t seen_harts{};
inline unsigned char byte_lock{};
inline unsigned protected_count{}, protected_inverse{~0u};

/*
 * Worker in each test thread to perform the clock checks.
*/
inline void worker(void *arg, void *, void *) {
  const auto index = reinterpret_cast<uintptr_t>(arg);
  // record which hart this worker reached
  atomic_or(&seen_harts, 1ul << replay::hart_id());

  // perform the clock checks
  // take the turns semaphore, publish the current time, and pass the turn to the next thread
  // check that the clock is monotonic across different harts
  uint64_t previous{};
  for (unsigned i = 0; i < 64; ++i) {
    if (k_sem_take(&turns[index], K_SECONDS(1)) != 0) {
      replay::fail("clock test handoff timed out");
      return;
    }
    uint64_t value{}, seq{};
    mailbox.read(value, seq);
    const auto now = k_cycle_get_64();
    if (now < previous || (seq && now < value))
      replay::fail("clock not monotonic across harts");
    previous = now;
    mailbox.publish(now);
    k_sem_give(&turns[(index + 1) % test_workers]);
  }

  // perform atomic operations, ensuring mutual exclusion
  for (unsigned i = 0; i < 1024; ++i) {
    while (__atomic_exchange_n(&byte_lock, 1, __ATOMIC_SEQ_CST))
      k_yield();
    if (protected_inverse != ~protected_count)
      replay::fail("atomic publication ordering failed");
    ++protected_count;
    protected_inverse = ~protected_count;
    __atomic_store_n(&byte_lock, 0, __ATOMIC_SEQ_CST);
  }
}

/*
 * Create temporary test threads, to verify behavior across different harts.
 * Validate results, return how many harts were online
*/
inline unsigned run() {

  for (unsigned i = 0; i < test_workers; ++i) {

    k_sem_init(&turns[i], i == 0 ? 1 : 0, 1);

    // create each thread without starting it 
    auto tid = k_thread_create(
        &threads[i], stacks[i], K_THREAD_STACK_SIZEOF(stacks[i]), worker,
        reinterpret_cast<void *>(static_cast<uintptr_t>(i)), nullptr, nullptr,
        3, 0, K_FOREVER);

#ifdef CONFIG_SCHED_CPU_MASK
    // if we enabled CPU affinity, pin the threads to specific CPUs
    if (k_thread_cpu_pin(tid, i % cpu_count) != 0)
      replay::fail("cannot pin clock test workers");
#endif

  }

  // start all the threads 
  for (unsigned i = 0; i < test_workers; ++i)
    k_thread_start(&threads[i]);

  // block calling main thread until all test threads are done
  for (unsigned i = 0; i < test_workers; ++i)
    k_thread_join(&threads[i], K_FOREVER);

  // each worker should have performed 1024 atomic operations
  if (protected_count != 1024 * test_workers)
    replay::fail("atomic mutual exclusion failed");

  // check that all harts were online
  const unsigned expected = (1u << cpu_count) - 1;
  const unsigned seen = atomic_get(&seen_harts);
  if (seen != expected)
    replay::fail("incorrect online hart mask");
  printf("ILLIXR_CLOCK "
         "{\"hart_mask\":%u,\"atomic_exchanges\":%u,\"timer_hz\":%llu,"
         "\"monotonic\":%s}\n",
         seen, protected_count,
         (unsigned long long)sys_clock_hw_cycles_per_sec(),
         replay::failed() ? "false" : "true");
  unsigned online = 0;
  for (unsigned bits = seen; bits; bits >>= 1)
    online += bits & 1;
  return online;
}

inline uint64_t core_cycles() {
  uint64_t value;
  __asm__ volatile("rdcycle %0" : "=r"(value));
  return value;
}

/*
 * Check the platform's clock and timer behavior across different harts.
 * ensure that hardware timer advances and its relationship to CPU cycles matches configured frequencies.
 * RISC-V mtime counter exposed through CLINT 
 */
inline void platform(unsigned online_harts) {
  // Stay runnable to prevent WFI clock gating from distorting the core/timer ratio.
  // Keep the two core-counter readings on the same hart. Prevents ordinary thread preemption during measurement
  k_sched_lock(); 
  const auto start_hart = replay::hart_id();
  // core_cycles reads rdcycle
  const auto start_core = core_cycles();
  // k_cycle_get_64 checks mtime
  const auto start_timer = k_cycle_get_64();

  // wait for approximately 10ms via hardware timer increments
  const uint64_t timer_hz = sys_clock_hw_cycles_per_sec();
  const uint64_t target_ticks = timer_hz / 100; 
  const uint64_t cycle_limit = ILLIXR_CORE_HZ ? ILLIXR_CORE_HZ / 10 : 100000000;
  while (k_cycle_get_64() - start_timer < target_ticks) {
    if (core_cycles() - start_core > cycle_limit) {
      replay::fail("platform timer did not advance");
      break;
    }
  }

  // measure elapsed counts and release scheduling lock
  const uint64_t ticks = k_cycle_get_64() - start_timer;
  const uint64_t cycles = core_cycles() - start_core;
  const auto end_hart = replay::hart_id();
  k_sched_unlock();

  // compare observed ratio against configuration expectation
  // e.g. on 1 GHz CPU and 1 MHz timer, 10ms -> 10000 timer increments, 10000000 cycles -> 1000 cycles/increment
  bool checked_ratio = false;
  if (ILLIXR_CORE_HZ && start_hart == end_hart && ticks > 0) {
    checked_ratio = true;
    const uint64_t measured = cycles * timer_hz;
    const uint64_t expected = ticks * static_cast<uint64_t>(ILLIXR_CORE_HZ);
    const uint64_t difference =
        measured > expected ? measured - expected : expected - measured;
    if (difference >
        expected / 20) // 5% allows MMIO reads and interrupt overhead.
      replay::fail("platform core/timer frequency mismatch");
  }
  if (ILLIXR_CORE_HZ && !checked_ratio)
    replay::fail("platform timer ratio check was not completed");
  printf("ILLIXR_PLATFORM "
         "{\"status\":\"%s\",\"online_harts\":%u,\"timer_hz\":%llu,"
         "\"elapsed_timer_ticks\":%llu,\"elapsed_core_cycles\":%llu,\"core_"
         "hz\":%llu,"
         "\"ratio_checked\":%s,\"start_hart\":%u,\"end_hart\":%u}\n",
         replay::failed() ? "fail" : "pass", online_harts,
         (unsigned long long)timer_hz, (unsigned long long)ticks,
         (unsigned long long)cycles, (unsigned long long)ILLIXR_CORE_HZ,
         checked_ratio ? "true" : "false", start_hart, end_hart);
}
} // namespace ILLIXR::clock_check
```

## src/data_format.hpp
```c
#pragma once
#include <cstddef>
#include "imu_sample.hpp"
#include <relative_clock.hpp>
#include <Eigen/Dense>
// in ../../src/data_format.hpp (approx)
namespace ILLIXR {
    using ullong = unsigned long long;

    struct ImuMsg {
        time_point      time;
        Eigen::Vector3d angular_v;
        Eigen::Vector3d linear_a;
        std::size_t index{};
    };

    inline ImuMsg imu_message(const ImuSample& sample) {
        return {time_point{std::chrono::nanoseconds{sample.timestamp_ns}},
                Eigen::Vector3d{sample.angular_v[0], sample.angular_v[1], sample.angular_v[2]},
                Eigen::Vector3d{sample.linear_a[0], sample.linear_a[1], sample.linear_a[2]},
                sample.index};
    }
    struct PoseMsg {
        time_point timestamp;
        Eigen::Vector3f position;        // [x, y, z] meters
        Eigen::Quaternionf orientation;  // (w, x, y, z)
    };
    struct ImuParams {
        double gyro_noise;           // Gyro white noise
        double acc_noise;            // Accel white noise
        double gyro_walk;            // Gyro bias random walk
        double acc_walk;             // Accel bias random walk
        Eigen::Vector3d n_gravity;   // Gravity vector
        double imu_integration_sigma;
        double nominal_rate;
    };
    struct ImuIntegratorInput {
        time_point timestamp;
        duration cam_imu_offset;
        ImuParams params;
        Eigen::Vector3d bias_accel;    // Current biases
        Eigen::Vector3d bias_gyro;
        Eigen::Vector3d position;      // Current full state
        Eigen::Vector3d velocity;
        Eigen::Quaterniond orientation;
    };

}
```

## src/data_format_opencv.hpp
```c
#pragma once
#include <cstddef>
#include <relative_clock.hpp>
#include <opencv2/core.hpp>
#include <Eigen/Dense>
// in ../../src/data_format.hpp (approx)
namespace ILLIXR {
    using ullong = unsigned long long;

    struct CamMsg {
        time_point      time;
        cv::Mat         img0;
        cv::Mat         img1;
        size_t          index{0};  // Original embedded stereo-pair index.
    };

}
```

## src/eye_tracking.hpp
```c
#pragma once
#include "latest_value.hpp"
#include <cstdint>
namespace ILLIXR::eye_tracking {
struct Image {
 const int8_t *pixels{};
 uint64_t sequence{};
 int64_t scheduled_ns{},published_ns{};
 unsigned publication_hart{};
};
struct Result {
 bool valid{};
 double x{},y{};
 uint64_t image_sequence{},inference_id{},output_hash{};
 int64_t image_ns{},snapshot_begin_ns{},request_ns{},start_ns{},completion_ns{},publication_ns{};
 unsigned accelerator_hart{},publication_hart{};
};
inline LatestValue<Image> latest_image;
void initialize();
void shutdown();
void publish(Image image);
// A retained snapshot; never starts or waits for inference. Invalid until the
// first result is published. The caller may observe the same result repeatedly.
Result latest();
Result read_latest(uint64_t warp_id, uint64_t display_slot);
void dump();
const int8_t *sample();
}
```

## src/fault_diagnostics.cpp
```c
// Diagnostic-only fatal path: avoid dropping the first register messages from
// Zephyr's small deferred log buffer. Normal execution is unaffected.
#include <zephyr/logging/log_ctrl.h>
#include <zephyr/sys/printk.h>
#include <zephyr/arch/riscv/exception.h>
extern "C" void __real_z_riscv_fault(arch_esf *);
extern "C" void __wrap_z_riscv_fault(arch_esf *frame) {
  unsigned long cause, value, pc;
  asm volatile("csrr %0, mcause" : "=r"(cause));
  asm volatile("csrr %0, mtval" : "=r"(value));
  asm volatile("csrr %0, mepc" : "=r"(pc));
  // Emit the trap location before draining deferred logs: a fault during
  // multicore logging must not hide these registers behind log_panic().
  printk("ILLIXR_CPU_FAULT mcause=%lx mtval=%lx mepc=%lx\n", cause, value, pc);
  log_panic();
  // Preserve the original faulting code layout: inspect only after a fatal
  // exception, without injecting calls into the image-processing hot path.
  // This diagnostic board has 256 MiB of RAM at 0x80000000.
  const auto sp = reinterpret_cast<unsigned long>(frame) + sizeof(*frame);
  if (sp >= 0x80000000UL && sp <= 0x90000000UL - 2048) {
    const auto *words = reinterpret_cast<const volatile unsigned long *>(sp);
    for (unsigned i = 0; i < 256; i += 4) {
      printk("ILLIXR_FAULT_STACK %lx %016lx %016lx %016lx %016lx\n",
             sp + i * sizeof(*words), words[i], words[i+1], words[i+2], words[i+3]);
    }
  }
  __real_z_riscv_fault(frame);
}
```

## src/gemmini_backend.hpp
```c
#pragma once
namespace ILLIXR::gemmini_backend {
void initialize();
void dump(const char *phase, bool reset = false);
bool self_test(unsigned &checks);
void shutdown();
}
```
